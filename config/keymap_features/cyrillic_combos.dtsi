/ {
    combos {
        compatible = "zmk,combos";

        combo_to_rus {
            bindings = <&to_russian>;
            key-positions = <17 18>;
            timeout-ms = <200>;
            require-prior-idle-ms = <300>;
        };

        combo_to_eng {
            bindings = <&to_eng>;
            key-positions = <29 30>;
            timeout-ms = <200>;
            require-prior-idle-ms = <300>;
        };

    };
};